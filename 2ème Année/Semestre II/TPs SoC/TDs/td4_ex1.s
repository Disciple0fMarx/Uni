; ---------------------------------------------------------------------------- ;
; ----------------------------- + Declarations + ----------------------------- ;
; ---------------------------------------------------------------------------- ;

  GPIO_base             EQU             0x4002_0000           ; Bases
  RCC_base              EQU             0x4002_3800

  AHB1ENR               EQU             0x30                  ; Offsets
  ODR                   EQU             0x14
  PUPDR                 EQU             0x0C
  MODER                 EQU             0x00
  OTYPER                EQU             0x04


  LDR                   R2,            =RCC_base
  LDR                   R3,            =GPIO_base

  LDR                   R1,            [R2,                    #AHB1ENR]
  ORR                   R1,             R1,                    #8
  STR                   R1,            [R2,                    #AHB1ENR]

; ---------------------------------------------------------------------------- ;
; ---------------------- + General purpose output mode + --------------------- ;
; ---------------------------------------------------------------------------- ;

  LDR                   R1,            [R3,                    #MODER]
  ORR                   R1,             R1,                    #(1 << 24)
  BIC                   R1,             R1,                    #(1 << 25)
  STR                   R1,            [R3,                    #MODER]

; ---------------------------------------------------------------------------- ;
; --------------------------- + Output Push-Pull + --------------------------- ;
; ---------------------------------------------------------------------------- ;

  LDR                   R1,            [R3,                    #OTYPER]
  BIC                   R1,             R1,                    #(1 << 12)
  STR                   R1,            [R3,                    #OTYPER]

; ---------------------------------------------------------------------------- ;
; ----------------------------- + PD12 Pulldown + ---------------------------- ;
; ---------------------------------------------------------------------------- ;

  LDR                   R1,            [R3,                    #PUPDR]
  ORR                   R1,             R1,                    #(1 << 24)
  BIC                   R1,             R1,                    #(1 << 25)
  STR                   R1,            [R3,                    #PUPDR]

; ---------------------------------------------------------------------------- ;
; -------------------------------- + PD12 On + ------------------------------- ;
; ---------------------------------------------------------------------------- ;

  LDR                   R1,            [R3,                    #ODR]
  ORR                   R1,             R1,                    #(1 << 12)
  STR                   R1,            [R3,                    #ODR]

; ---------------------------------------------------------------------------- ;
; ------------------------------- + PD12 Off + ------------------------------- ;
; ---------------------------------------------------------------------------- ;

;  LDR                   R1,            [R3,                    #ODR]
;  ORR                   R1,             R1,                    #(1 << 12)
;  STR                   R1,            [R3,                    #ODR]
